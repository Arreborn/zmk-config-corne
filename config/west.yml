## config/west.yml
```yaml
manifest:
  remotes:
    - name: zmkfirmware
      url-base: https://github.com/zmkfirmware
    - name: kevinpastor
      url-base: https://github.com/kevinpastor
    - name: urob
      url-base: https://github.com/urob
  projects:
    - name: zmk
      remote: zmkfirmware
      revision: main
      import: app/west.yml
    - name: nice-view-elemental
      remote: kevinpastor
      revision: main
    - name: zmk-adaptive-key
      remote: urob
      revision: v0.3
    - name: zmk-auto-layer
      remote: urob
      revision: v0.3
  self:
    path: config
```
